## config/boards/shields/third/Kconfig.defconfig
```kconfig
if SHIELD_THIRD_LEFT

config ZMK_KEYBOARD_NAME
    default "Third"

config ZMK_SPLIT_ROLE_CENTRAL
    default y

endif

if SHIELD_THIRD_LEFT || SHIELD_THIRD_RIGHT

config ZMK_SPLIT
    default y

endif
```

## config/boards/shields/third/Kconfig.shield
```kconfig
config SHIELD_THIRD_LEFT
    def_bool $(shields_list_contains,third_left)

config SHIELD_THIRD_RIGHT
    def_bool $(shields_list_contains,third_right)
    
```
