## config/boards/shields/eighth/Kconfig.defconfig
```kconfig
if SHIELD_EIGHTH_LEFT

config ZMK_KEYBOARD_NAME
    default "TN Eighth"

config ZMK_SPLIT_ROLE_CENTRAL
    default y

endif

if SHIELD_EIGHTH_LEFT || SHIELD_EIGHTH_RIGHT

config ZMK_SPLIT
    default y

endif
```

## config/boards/shields/eighth/Kconfig.shield
```kconfig
config SHIELD_EIGHTH_LEFT
    def_bool $(shields_list_contains,eighth_left)

config SHIELD_EIGHTH_RIGHT
    def_bool $(shields_list_contains,eighth_right)
```
